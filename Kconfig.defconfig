## Kconfig.defconfig
```kconfig
# Copyright (c) 2022 The ZMK Contributors
# SPDX-License-Identifier: MIT

if SHIELD_PETERSON30

config ZMK_KEYBOARD_NAME
    default "Peterson30"

endif
```

## Kconfig.shield
```kconfig
# Copyright (c) 2022 The ZMK Contributors
# SPDX-License-Identifier: MIT

config SHIELD_PETERSON30
   def_bool $(shields_list_contains,peterson30)
```
